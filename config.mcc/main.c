// Code generated by MCHP Chatbot

#include "mcc_generated_files/system/system.h"
#include "mcc_generated_files/timer/tmr0.h"
#include "hc164.h"

#define ANCHO_MATRIZ 25
#define ALTO_MATRIZ 7
#define COLUMNA_NAVE 4
#define DIVISOR_SCROLL 40
#define DEBOUNCE_FRAMES 3
#define TMR0_INTERVAL_100US 65486U

static volatile uint8_t columna_actual = 0;
static volatile uint8_t clk_switch = 0;
static volatile uint8_t frames_pendientes = 0;
static volatile uint8_t mapa_activo = 0;
static volatile uint8_t juego_iniciado = 0;
static volatile uint8_t juego_terminado = 0;
static volatile uint8_t posicion_nave = 3;
static volatile uint8_t mapas[2][ANCHO_MATRIZ];

static uint8_t centro_hueco = 3;
static uint8_t semilla_aleatoria = 0xA5;

static uint8_t generar_columna_mapa(void) {
    uint8_t fila;
    uint8_t obstaculos = 0;
    uint8_t variacion_hueco;

    semilla_aleatoria = (uint8_t)((semilla_aleatoria >> 1) ^
        ((semilla_aleatoria & 1) ? 0xB8 : 0));
    variacion_hueco = semilla_aleatoria % 3;
    if(variacion_hueco == 0 && centro_hueco > 2) {
        centro_hueco--;
    } else if(variacion_hueco == 2 && centro_hueco < 4) {
        centro_hueco++;
    }

    for(fila = 0; fila < ALTO_MATRIZ; fila++) {
        if(fila < centro_hueco - 1 || fila > centro_hueco + 1) {
            obstaculos |= (uint8_t)(1u << fila);
        }
    }
    return obstaculos;
}

static void inicializar_mapa(void) {
    uint8_t columna;
    for(columna = 0; columna < ANCHO_MATRIZ; columna++) {
        mapas[0][columna] = generar_columna_mapa();
        mapas[1][columna] = mapas[0][columna];
    }
    mapas[0][COLUMNA_NAVE] &= 0x41;
    mapas[1][COLUMNA_NAVE] = mapas[0][COLUMNA_NAVE];
    mapa_activo = 0;
}

static uint8_t desplazar_mapa(void) {
    uint8_t columna;
    uint8_t mapa_nuevo = mapa_activo ^ 1;
    uint8_t fila_nave = (uint8_t)(1u << posicion_nave);

    for(columna = 0; columna < ANCHO_MATRIZ - 1; columna++) {
        mapas[mapa_nuevo][columna] = mapas[mapa_activo][columna + 1];
    }
    mapas[mapa_nuevo][ANCHO_MATRIZ - 1] = generar_columna_mapa();

    mapa_activo = mapa_nuevo;
    return (mapas[mapa_nuevo][COLUMNA_NAVE] & fila_nave) != 0;
}

static void actualizar_boton(uint8_t presionado, uint8_t *contador,
                             uint8_t *estado, int8_t movimiento) {
    if(presionado) {
        if(*contador < DEBOUNCE_FRAMES) {
            (*contador)++;
        }
        if(*contador == DEBOUNCE_FRAMES && *estado == 0) {
            *estado = 1;
            juego_iniciado = 1;
            juego_terminado = 0;
            if(movimiento < 0 && posicion_nave > 0) {
                posicion_nave--;
            } else if(movimiento > 0 && posicion_nave < ALTO_MATRIZ - 1) {
                posicion_nave++;
            }
            if(mapas[mapa_activo][COLUMNA_NAVE] & (1u << posicion_nave)) {
                juego_terminado = 1;
            }
        }
    } else {
        if(*contador > 0) {
            (*contador)--;
        }
        if(*contador == 0) {
            *estado = 0;
        }
    }
}

void TMR0_CustomISR(void) {
    if (clk_switch == 0) {
        uint8_t pixeles;
        if(!juego_iniciado) {
            pixeles = (columna_actual == COLUMNA_NAVE)
                ? (uint8_t)(1u << posicion_nave) : 0;
        } else {
            pixeles = mapas[mapa_activo][columna_actual];
            if(columna_actual == COLUMNA_NAVE) {
                pixeles |= (uint8_t)(1u << posicion_nave);
            }
        }
        LATB = (uint8_t)(~pixeles);

        CLK_SetHigh();
        if(columna_actual == 0) {
            AB_SetHigh();
        } else {
            AB_SetLow();
        }
        clk_switch = 1;
    } else {
        CLK_SetLow();
        columna_actual++;
        if(columna_actual >= ANCHO_MATRIZ) {
            columna_actual = 0;
            if(frames_pendientes < 0xFF) {
                frames_pendientes++;
            }
        }
        clk_switch = 0;
    }
}

int main(void) {
    uint8_t contador_subir = 0;
    uint8_t contador_bajar = 0;
    uint8_t subir_presionado = 0;
    uint8_t bajar_presionado = 0;
    uint8_t frames_scroll = 0;
    uint8_t procesar_frame;

    SYSTEM_Initialize();
    hc164_init();
    TMR0_PeriodSet(TMR0_INTERVAL_100US);
    TMR0_CounterSet(TMR0_INTERVAL_100US);
    ANCON0bits.ANSEL0 = 0;
    ANCON0bits.ANSEL1 = 0;
    TRISAbits.TRISA0 = 1;
    TRISAbits.TRISA1 = 1;
    LATB = 0x7F;
    inicializar_mapa();

    TMR0_OverflowCallbackRegister(TMR0_CustomISR);
    TMR0_TMRInterruptEnable();
    INTCONbits.PEIE = 1;
    INTCONbits.GIE = 1;

    while(1) {
        procesar_frame = 0;
        if(frames_pendientes != 0) {
            INTCONbits.GIE = 0;
            if(frames_pendientes != 0) {
                frames_pendientes--;
                procesar_frame = 1;
            }
            INTCONbits.GIE = 1;
        }

        if(procesar_frame) {
            actualizar_boton(PORTAbits.RA0 == 0, &contador_subir,
                             &subir_presionado, -1);
            actualizar_boton(PORTAbits.RA1 == 0, &contador_bajar,
                             &bajar_presionado, 1);

            if(juego_iniciado && !juego_terminado) {
                frames_scroll++;
                if(frames_scroll >= DIVISOR_SCROLL) {
                    frames_scroll = 0;
                    if(desplazar_mapa()) {
                        juego_terminado = 1;
                    }
                }
            }
        }
    }
}


